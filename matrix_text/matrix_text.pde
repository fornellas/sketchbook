#include <avr/pgmspace.h>
#include <math.h>

#define PIN_SCK  13
#define PIN_MISO 12
#define	PIN_MOSI 11
#define PIN_SS   10

#define N_DISP 2

#define ThermistorPIN 0

char frameBuf[64*N_DISP];

prog_uchar font[] PROGMEM = {
  0x00, 0x00, 0x00, 0x00, 0x00, 0x00, 0x00, 0x00, // Char_032 
  0x30, 0x78, 0x78, 0x30, 0x30, 0x00, 0x30, 0x00, // Char_033 !
  0x6C, 0x6C, 0x6C, 0x00, 0x00, 0x00, 0x00, 0x00, // Char_034 "
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  0x76, 0xDC, 0x00, 0x00, 0x00, 0x00, 0x00, 0x00, // Char_126 ~
};
#define CHAR_MIN 32
#define CHAR_MAX 126

double Thermistor(int RawADC) {
  long Resistance;  
  double Temp;
  Resistance=((10240000/RawADC) - 10000);
  Temp = log(Resistance);
  Temp = 1 / (0.001129148 + (0.000234125 * Temp) + (0.0000000876741 * Temp * Temp * Temp));
  Temp = Temp - 273.15;
  return Temp;
}

void printDouble(double val, byte precision) {
  Serial.print (int(val));
  if( precision > 0) {
    Serial.print(".");
    unsigned long frac, mult = 1;
    byte padding = precision -1;
    while(precision--) mult *=10;
    if(val >= 0) frac = (val - int(val)) * mult; 
    else frac = (int(val) - val) * mult;
    unsigned long frac1 = frac;
    while(frac1 /= 10) padding--;
    while(padding--) Serial.print("0");
    Serial.print(frac,DEC) ;
  }
}

void sendChar(char cData){
  SPDR = cData;
  while(!(SPSR&(1<<SPIF)));
}

void sendFrame(char *frame) {
  byte d, x, y;
  char c;
  for(d=0;d<N_DISP;d++){
    digitalWrite(PIN_SS, LOW);
    delayMicroseconds(500);
    for(x=0;x<8;x++)
      for(y=0;y<8;y++){
        c=*(frame + 8*N_DISP*x + (N_DISP-(d+1))*8 + (7-y) );
        if(d==0)
          if(c&7<<5&&c&7<<2)
            c=(c&B00011111)|((((c&B11100000)>>5)-1)<<5);
        if('%'==c)
          sendChar('%'-1);
        else
          sendChar(c);
      }
    digitalWrite(PIN_SS, HIGH);
    delayMicroseconds(10);
  }
}

void setup(){
  SPCR=(1<<SPE)|(1<<MSTR)|(1<<SPR1)|(1<<SPR0);
  SPSR = SPSR & B11111110;

  pinMode(PIN_SCK, OUTPUT);
  digitalWrite(PIN_SCK, LOW);
  pinMode(PIN_MOSI, OUTPUT);
  pinMode(PIN_SS, OUTPUT);
  digitalWrite(PIN_SS, HIGH);
  delayMicroseconds(500);

  digitalWrite(PIN_SS, LOW);
  delayMicroseconds(500);
  sendChar('%');
  sendChar(N_DISP);
  digitalWrite(PIN_SS, HIGH);
  delayMicroseconds(10);
  Serial.begin(115200);

  for(byte c;c<64*N_DISP;c++)
    frameBuf[c]=0;

}

void loop(){
  double temp;
  char string[] = "  Hello World!  ";

  temp=Thermistor(analogRead(ThermistorPIN));
  Serial.print("Temperature: ");
  printDouble(temp,3);
  Serial.println("");

  for(byte c=0;c<strlen(string)-1;c++) {
    for(byte x=0;x<8;x++) {
      for(byte y=0;y<8;y++) {
        byte f;
        if( pgm_read_word_near(font+(string[c]-CHAR_MIN)*8+y) & (1<<(7-x)) )
          f=y|3;
        else
          f=1<<5;
        frameBuf[y*8*N_DISP+x]=f;
        if( pgm_read_word_near(font+(string[c+1]-CHAR_MIN)*8+y) & (1<<(7-x)) )
          f=y|3;
        else
          f=1<<5;
        frameBuf[y*8*N_DISP+x+8]=f;
      }
    }
    sendFrame(frameBuf);
    delay(500*2);
  }

}



